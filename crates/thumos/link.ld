/* Linker script for thumos on MT6739 */
/* Kernel loads at 0x40008000 (same as Linux on this platform) */

ENTRY(_start)

SECTIONS
{
    . = 0x40008000;

    /* WHY (#417): page-aligned section boundaries so the MMU can map the
       kernel image with W^X permissions per 4 KB page -- .text executable
       but read-only, .rodata read-only + execute-never, data/bss writable +
       execute-never. See mmu::map_kernel_wx. */
    . = ALIGN(4096);
    __text_start = .;
    .text : {
        *(.text.boot)
        *(.text .text.*)
    }

    . = ALIGN(4096);
    __etext = .;
    .rodata : ALIGN(4) {
        *(.rodata .rodata.*)
    }

    . = ALIGN(4096);
    __erodata = .;
    .data : ALIGN(4) {
        *(.data .data.*)
    }

    .bss : ALIGN(4) {
        __bss_start = .;
        *(.bss .bss.*)
        *(COMMON)
        __bss_end = .;
    }

    . = ALIGN(4096);
    /* WHY(#465): the kernel proper (kinit + the kardia service loop = PID 0)
       runs in SYSTEM mode on __stack_top, so every schedulable context shares
       the user/system register bank -- this lets the exception stubs capture
       and restore the interrupted sp/lr with a single user-bank ldm/stm ^,
       with no SPSR-mode decoding. SVC is now a transient trap mode with its
       own stack (like IRQ/ABT/UND): every syscall unwinds the SVC stack before
       the next process resumes, so one 16 KB stack serves all processes. */
    __stack_top = . + 0x10000;                  /* SYS boot / PID-0 stack (64 KB) */
    __irq_stack_top = __stack_top + 0x1000;     /* IRQ banked stack (4 KB) */
    __abt_stack_top = __irq_stack_top + 0x1000; /* ABT banked stack (4 KB) */
    __und_stack_top = __abt_stack_top + 0x1000; /* UND banked stack (4 KB) */
    __svc_stack_top = __und_stack_top + 0x4000; /* SVC syscall stack (16 KB) */

    /DISCARD/ : {
        *(.comment)
        *(.ARM.attributes)
        *(.ARM.exidx*)
    }
}

/* Kernel image + all stacks must stay inside the reserved window ending at
   kconfig::KERNEL_END (0x40100000): page::init hands out frames from there
   up, so an oversized image would be silently overwritten by allocations. */
/* __kernel_end, GENERATED by build.rs from board::KERNEL_LOAD +
   board::KERNEL_RESERVED (#917). A linker script cannot read a Rust constant,
   and a second written copy drifts silently in the direction that matters: a
   larger bound here accepts an image past the last L1 section mmu maps, and
   the first report is a data abort on device. Never assign __kernel_end in
   this file -- edit board/mod.rs and both sides move together.
   scripts/check-kernel-window.sh enforces that shape. */
INCLUDE kernel_window.ld
ASSERT(__svc_stack_top <= __kernel_end, "kernel image + stacks exceed KERNEL_RESERVED; raise board::KERNEL_RESERVED, the sole window-size knob, or reclaim space (run scripts/check-kernel-window.sh for nm --size-sort diagnostics; issue #917)")
